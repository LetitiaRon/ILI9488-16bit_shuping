## components/lvgl_port/Kconfig
```kconfig
menu "lvgl port configuration"

    choice LVGL_LCD_PANEL_SELECT
        prompt "LCD panel"
        default LVGL_LCD_PANEL_W350CE024A_40Z

        help
            This selects the initialization register table for specific LCD panels.
            You can select one from those tested models, or you may add your own panel
            initialization register table inside components/bsp/bsp_lcd_panels.c.

        config LVGL_LCD_PANEL_W350CE024A_40Z
            bool "W350CE024A-40Z (ST7796S, IPS)"

        config LVGL_LCD_PANEL_CL35BC1017_40A
            bool "CL35BC1017-40A (ST7796S, TN)"

        config LVGL_LCD_PANEL_CL35BC106_40A
            bool "CL35BC106-40A (ILI9488, TN)"
            
        config LVGL_LCD_PANEL_P0395H01_SPEC_40A
            bool "P0395H01-40A (ILI9488, TN)"
    endchoice

    config LVGL_LCD_PCLK_FREQ
        int "LCD pixel clock frequency in MHz"
        default 12
        range 2 15

        help
            This selects the pixel frequency of the driver. Higher frequency improves fps
            but may cause glitches in graphics or even prevent the screen from functioning.
            How high the frequency could reach depends on the hardware (route on the pcb,
            for example) and lcd driver chip specs. Choose as high frequency as possible
            while the graphics is fine.

endmenu
```

## sdkconfig.defaults
```kconfig
CONFIG_ESPTOOLPY_FLASHMODE_QIO=y
CONFIG_ESPTOOLPY_FLASHFREQ_120M=y
CONFIG_COMPILER_OPTIMIZATION_PERF=y
CONFIG_ESP32S3_DEFAULT_CPU_FREQ_240=y
CONFIG_ESP32S3_INSTRUCTION_CACHE_32KB=y
CONFIG_ESP32S3_DATA_CACHE_64KB=y
# CONFIG_ESP_TASK_WDT is not set
CONFIG_LV_MEM_CUSTOM=y
CONFIG_LV_DISP_DEF_REFR_PERIOD=20
CONFIG_LV_INDEV_DEF_READ_PERIOD=100
CONFIG_LV_USE_PERF_MONITOR=y
CONFIG_LV_FONT_MONTSERRAT_10=y
CONFIG_LV_FONT_MONTSERRAT_12=y
CONFIG_LV_FONT_MONTSERRAT_16=y
CONFIG_LV_FONT_MONTSERRAT_18=y
CONFIG_LV_FONT_MONTSERRAT_20=y
CONFIG_LV_FONT_MONTSERRAT_22=y
CONFIG_LV_FONT_MONTSERRAT_24=y
CONFIG_LV_USE_FONT_COMPRESSED=y
CONFIG_LV_USE_DEMO_BENCHMARK=y
CONFIG_LV_USE_DEMO_MUSIC=y
CONFIG_LV_DEMO_MUSIC_AUTO_PLAY=y
```
